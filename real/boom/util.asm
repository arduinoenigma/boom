;;;;;;;;;;;;;;;;;;;;;;;;;;;;;;;;;;;;;;;;;;;;;;;;;;;;;;;;;;;;;;;;;;;;;;;;;;;;;
; util.asm
;
; Generic utility routines
;
; Dec 20, 2016 - Jim Shortz (hackaday.io/jimshortz)
;
;;;;;;;;;;;;;;;;;;;;;;;;;;;;;;;;;;;;;;;;;;;;;;;;;;;;;;;;;;;;;;;;;;;;;;;;;;;;;

;;;;;;;;;;;;;;;;;;;;;;;;;;;;;;;;;;;;;;;;;;;;;;;;;;;;;;;;;;;;;;;;;;;;;;;
; copyp
;
; Copies program memory to data memory.  Copies each byte of
; program memory to a word of data memory and performs sign extension.
;
; Inputs:
;	Z -		Source address in program memory
;	Y -		Destination address in data memory
;	r16 -	Number of source bytes to copy
;
; Outputs:
;	Y -		Y+r16
;	Z -		Z+r16
;;;;;;;;;;;;;;;;;;;;;;;;;;;;;;;;;;;;;;;;;;;;;;;;;;;;;;;;;;;;;;;;;;;;;;;
copyp:
    lpm		r0, z+     
    clr     r1
    sbrc    r0, 7       ; Sign extend
    com     r1
    st		y+, r0
    st      y+, r1
    dec		r16
    brne	copyp
    ret

;;;;;;;;;;;;;;;;;;;;;;;;;;;;;;;;;;;;;;;;;;;;;;;;;;;;;;;;;;;;;;;;;;;;;;;
; copy
;
; Copy data memory to data memory.
;
; Inputs:
;	r16 -	Count
;	Z -		Source (data space)
;	Y -		Destination (data space)
;
; Affects: r0
;;;;;;;;;;;;;;;;;;;;;;;;;;;;;;;;;;;;;;;;;;;;;;;;;;;;;;;;;;;;;;;;;;;;;;;
copy:
    ld		r0, z+
    st		y+, r0
    dec		r16
    brne	copy
    ret

;;;;;;;;;;;;;;;;;;;;;;;;;;;;;;;;;;;;;;;;;;;;;;;;;;;;;;;;;;;;;;;;;;;;;;;
; delay50
;
; Delays approximately 50ms
;
; Affects: r18, r19, r20
;;;;;;;;;;;;;;;;;;;;;;;;;;;;;;;;;;;;;;;;;;;;;;;;;;;;;;;;;;;;;;;;;;;;;;;
delay50:
; Generated by delay loop calculator
; at http://www.bretmulvey.com/avrdelay.html
;
; Delay 800 000 cycles
; 50ms at 16 MHz

    ldi  r18, 5
    ldi  r19, 15
    ldi  r20, 242
L1: dec  r20
    brne L1
    dec  r19
    brne L1
    dec  r18
    brne L1
    ret

;;;;;;;;;;;;;;;;;;;;;;;;;;;;;;;;;;;;;;;;;;;;;;;;;;;;;;;;;;;;;;;;;;;;;;;
; mul168u
;
; Multiply a 16-bit unsigned by an 8-bit unsigned
;
; Inputs:
;	r2, r3	- 16-bit number
;	r18		- 8-bit number
; Outputs:
;	r0, r1	- 16-bit result
; Affects:
;	r5
;;;;;;;;;;;;;;;;;;;;;;;;;;;;;;;;;;;;;;;;;;;;;;;;;;;;;;;;;;;;;;;;;;;;;;;
mul168u:
    mul		r3, r18
    mov		r5, r0
    mul		r2, r18
    add		r1, r5
    ret

;;;;;;;;;;;;;;;;;;;;;;;;;;;;;;;;;;;;;;;;;;;;;;;;;;;;;;;;;;;;;;;;;;;;;;;
; div168u/div16u
;
; Divides 16-bit unsigned number by an 8 or 16-bit divisor.
; Based on AVR200 div16u code from Atmel
;
; Inputs:
;	r0,r1 -		Dividend
;	r18,r19 -	Divisor (omit r19 for div168u)
;
; Outputs:
;	r0,r1 -		Quotient
;	r14,r15 -	Remainder			
;
; Affected:
;	r20
;;;;;;;;;;;;;;;;;;;;;;;;;;;;;;;;;;;;;;;;;;;;;;;;;;;;;;;;;;;;;;;;;;;;;;;
div168u:
    clr		r19		; We always take an 8 bit divisor
div16u:	
    clr		r14		; clear remainder Low byte
    sub		r15,r15	; clear remainder High byte and carry
    ldi		r20,17	; init loop counter
d16u_1:	
    rol		r0		; shift left dividend
    rol		r1
    dec		r20		; decrement counter
    brne	d16u_2	; if done
    ret				;    return
d16u_2:	
    rol		r14		; shift dividend into remainder
    rol		r15
    sub		r14,r18	; remainder = remainder - divisor
    sbc		r15,r19	;
    brcc	d16u_3	; if result negative
    add		r14,r18	;    restore remainder
    adc		r15,r19
    clc				; clear carry to be shifted into result
    rjmp	d16u_1		;else
d16u_3:	
    sec			;    set carry to be shifted into result
    rjmp	d16u_1	

;;;;;;;;;;;;;;;;;;;;;;;;;;;;;;;;;;;;;;;;;;;;;;;;;;;;;;;;;;;;;;;;;;;;;;;
; rand
;
; Generate a pseudo-random number
;
; Outputs:
;   r18     - Number
;   rseed   - Updated seed 
;
; Adapted from http://atariage.com/forums/topic/159268-random-numbers/?p=1958751
;;;;;;;;;;;;;;;;;;;;;;;;;;;;;;;;;;;;;;;;;;;;;;;;;;;;;;;;;;;;;;;;;;;;;;;
rand:
    lsr     rseed
    brcc    rand1
    ldi     r18, 0xb4
    eor     rseed, r18
rand1:
    mov     r18, rseed
    ret
